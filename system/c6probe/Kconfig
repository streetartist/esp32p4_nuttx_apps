## system/c6probe/Kconfig
```kconfig
config SYSTEM_C6PROBE
	tristate "ESP32-C6 ESP-Hosted SDIO probe"
	default n
	depends on ARCH_CHIP_ESP32P4 && ESP32P4_SDMMC
	---help---
		Enable the c6probe NSH command.  It resets the on-board ESP32-C6
		and verifies the ESP-Hosted SDIO Function 1 link without starting
		Wi-Fi or Bluetooth.

if SYSTEM_C6PROBE

config SYSTEM_C6PROBE_PROGNAME
	string "c6probe program name"
	default "c6probe"

config SYSTEM_C6PROBE_PRIORITY
	int "c6probe task priority"
	default 100

config SYSTEM_C6PROBE_STACKSIZE
	int "c6probe stack size"
	default 4096

endif
```

## system/desktop/Kconfig
```kconfig
#
# For a description of the syntax of this configuration file,
# see the file kconfig-language.txt in the NuttX tools repository.
#

menuconfig SYSTEM_DESKTOP
	tristate "NuttX touch desktop launcher"
	default n
	depends on GRAPHICS_LVGL
	---help---
		Touch desktop launcher for framebuffer-based NuttX boards.
		Shows a status bar and an application grid, and lists quick apps
		found under /data/qpk.

if SYSTEM_DESKTOP

config SYSTEM_DESKTOP_PROGNAME
	string "Program name"
	default "desktop"

config SYSTEM_DESKTOP_PRIORITY
	int "Desktop task priority"
	default 100

config SYSTEM_DESKTOP_STACKSIZE
	int "Desktop stack size"
	default 32768

config SYSTEM_DESKTOP_QPK_DIR
	string "Quick app directory"
	default "/data/qpk"

config SYSTEM_DESKTOP_FILEMGR_ROOT
	string "File manager root directory"
	default "/data"

config SYSTEM_DESKTOP_FILEMGR_PORT
	int "File manager HTTP port"
	default 8080
	range 1 65535

endif
```
